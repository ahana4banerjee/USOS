## Kconfig
```kconfig
menu "USOS (Universal Sensor Operating System)"

    config USOS_MAX_SENSORS
        int "Maximum number of statically registered sensors"
        default 8
        range 1 32
        help
            Fixed compile-time size of the USOS static sensor registry.

    config USOS_OBS_QUEUE_LEN
        int "Observation event queue capacity"
        default 16
        range 8 256
        help
            Number of fixed-size observation events buffered between
            application wrappers and the USOS supervisor task.

    config USOS_TASK_STACK_SIZE
        int "USOS supervisor task stack size (bytes)"
        default 4096
        range 2048 16384
        help
            Static stack size allocated for usos_task.

    config USOS_TASK_PRIORITY
        int "USOS supervisor task FreeRTOS priority"
        default 3
        range 1 24
        help
            Priority of usos_task (keep below time-critical control tasks).

    config USOS_OBS_PERIOD_MS
        int "Periodic runtime/resource observation interval (ms)"
        default 1000
        range 100 60000
        help
            How often usos_task samples runtime, heap, and resource metrics.

    config USOS_MAX_TRACKED_TASKS
        int "Maximum FreeRTOS tasks tracked in runtime snapshot"
        default 24
        range 2 32
        help
            Static array capacity for FreeRTOS task state/stack snapshots.

    config USOS_ENABLE_RUNTIME_MONITOR
        bool "Enable FreeRTOS runtime & task monitoring"
        default y
        help
            Collects FreeRTOS task states, CPU utilization, heap, and stack HWM.

    config USOS_ENABLE_RESOURCE_MONITOR
        bool "Enable USOS self-resource overhead monitoring"
        default y
        help
            Tracks USOS static RAM, queue peaks/drops, and supervisor stack HWM.

    config USOS_OBS_LOG_SUMMARY
        bool "Log periodic observation summary to console"
        default y
        help
            Enable compact periodic observation logs for diagnostics/demos.

endmenu
```
